## conf/distro/poky-swi-ext.conf
```bitbake
DISTRO_FEATURES_DEFAULT ?= "argp ext2 irda largefile usbgadget usbhost wifi xattr nfs 3g nfc"

require conf/distro/poky.conf

DISTRO = "poky-swi-ext"
DISTROOVERRIDES = "poky"

SDKPATH_PREFIX ?= "y17-ext"
SDKPATH = "/opt/swi/${SDKPATH_PREFIX}"

POKY_DEFAULT_DISTRO_FEATURES = "largefile multiarch"
```

## conf/layer.conf
```bitbake
# We have a conf and classes directory, add to BBPATH
BBPATH .= ":${LAYERDIR}"

# We have a recipes directory, add to BBFILES
BBFILES += "${LAYERDIR}/common/recipes*/*/*.bb \
	${LAYERDIR}/common/recipes*/*/*.bbappend"

BBFILE_COLLECTIONS += "swi-extras"
BBFILE_PRIORITY_swi-extras = "15"
BBFILE_PATTERN_swi-extras := "^${LAYERDIR}/common/recipes/"
```

## meta-swi-bin/conf/layer.conf
```bitbake
# We have a conf and classes directory, add to BBPATH
BBPATH .= ":${LAYERDIR}"

# We have a recipes directory, add to BBFILES
BBFILES += "${LAYERDIR}/recipes/*/*.bb \
        ${LAYERDIR}/recipes/*/*.bbappend"

BBFILE_COLLECTIONS += "swi-bin"
BBFILE_PRIORITY_swi-bin = "20"
BBFILE_PATTERN_swi-bin := "^${LAYERDIR}/"
```

## meta-swi-src/conf/distro/poky-swi-int.conf
```bitbake
require conf/distro/poky.conf

DISTRO = "poky-swi-int"
DISTROOVERRIDES = "poky"
SDKPATH = "/opt/swi/y16-int"
```

## meta-swi-src/conf/layer.conf
```bitbake
# We have a conf and classes directory, add to BBPATH
BBPATH .= ":${LAYERDIR}"

# We have a recipes directory, add to BBFILES
BBFILES += "${LAYERDIR}/recipes/*/*.bb \
        ${LAYERDIR}/recipes/*/*.bbappend"

BBFILE_COLLECTIONS += "swi-src"
BBFILE_PRIORITY_swi-src = "30"
BBFILE_PATTERN_swi-src := "^${LAYERDIR}/recipes/"

LICENSE_PATH += "${LAYERDIR}/files/qcom-licenses"
```
